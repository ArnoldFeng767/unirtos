## qos_applications/unirtos_std/Kconfig
```kconfig
# Copyright (C) 2023 UniRTOS.
# All rights reserved.
#

menu "UniRTOS AT Standard"

config QAPP_UNIRTOS_CAMERA_AT_FUNC
    bool "Enable Camera AT command"
    select QAPP_UNIRTOS_STD_FUNC
    select QOSA_CAMERA_FUNC
    default n

config QAPP_UNIRTOS_FILE_AT_FUNC
    bool "Enable File AT command"
    select QAPP_UNIRTOS_STD_FUNC
    select QCM_FILE_API_FUNC
    select QCM_UTILS_UTILS_FUNC
    default n

config QAPP_UNIRTOS_TCPIP_AT_FUNC
    bool "Enable TCP/IP AT command"
    select QAPP_UNIRTOS_STD_FUNC
    select QCM_SOCKET_ADP_FUNC
    select QCM_URC_FUNC
    select QCM_UTILS_UTILS_FUNC
    default n

config QAPP_UNIRTOS_TCPIP_NB_AT_FUNC
    bool "Enable TCP/IP NB-IoT AT command"
    select QAPP_UNIRTOS_STD_FUNC
    select QCM_SOCKET_ADP_FUNC
    select QCM_URC_FUNC
    select QCM_UTILS_UTILS_FUNC
    default n

config QAPP_UNIRTOS_SSL_AT_FUNC
    bool "Enable SSL AT command"
    select QAPP_UNIRTOS_STD_FUNC
    select QCM_VTLS_FUNC
    select QCM_FILE_API_FUNC
    default n

config QAPP_UNIRTOS_SSL_AT_PSK_FUNC
    bool "Enable SSL PSK AT command"
    select QAPP_UNIRTOS_SSL_AT_FUNC
    default n

config QAPP_UNIRTOS_HTTP_AT_FUNC
    bool "Enable HTTP AT command"
    select QAPP_UNIRTOS_STD_FUNC
    select QCM_QURL_HTTP_FUNC
    select QCM_URC_FUNC
    select QCM_QURL_FUNC
    default n

config QAPP_UNIRTOS_FTP_AT_FUNC
    bool "Enable FTP AT command"
    select QAPP_UNIRTOS_STD_FUNC
    select QCM_QURL_FTP_FUNC
    select QCM_URC_FUNC
    select QCM_UTILS_UTILS_FUNC
    select QCM_QURL_FUNC
    default n

config QAPP_UNIRTOS_GCOV_AT_FUNC
    bool "Enable GCOV AT command"
    select QAPP_UNIRTOS_STD_FUNC
    default n

config QAPP_UNIRTOS_SMTP_AT_FUNC
    bool "Enable SMTP AT command"
    select QAPP_UNIRTOS_STD_FUNC
    select QCM_QURL_SMTP_FUNC
    select QCM_UTILS_UTILS_FUNC
    select QCM_URC_FUNC
    select QCM_QURL_FUNC
    select QCM_UTILS_BASE64_FUNC
    default n

config QAPP_UNIRTOS_COAP_AT_FUNC
    bool "Enable CoAP AT command"
    select QAPP_UNIRTOS_STD_FUNC
    select QCM_COAP_FUNC
    select QCM_COAP_API_FUNC
    select QCM_URC_FUNC
    select QCM_UTILS_UTILS_FUNC
    default n

config QAPP_UNIRTOS_LWM2M_AT_FUNC
    bool "Enable LwM2M AT command"
    select QAPP_UNIRTOS_STD_FUNC
    select QCM_LWM2M_FUNC
    select QCM_LWM2M_FOTA_FUNC
    select QCM_URC_FUNC
    select QCM_UTILS_UTILS_FUNC
    select QCM_LWM2M_DTLS_FUNC
    default n

config QAPP_UNIRTOS_ONENET_LWM2M_AT_FUN
    bool "Enable LwM2M ONENET AT command"
    select QAPP_UNIRTOS_STD_FUNC
    select QCM_LWM2M_FUNC
    select QCM_LWM2M_FOTA_FUNC
    select QCM_URC_FUNC
    select QCM_UTILS_UTILS_FUNC
    default n

config QAPP_UNIRTOS_AEP_LWM2M_AT_FUN
    bool "Enable LwM2M AEP AT command"
    select QAPP_UNIRTOS_STD_FUNC
    select QCM_LWM2M_FUNC
    select QCM_LWM2M_FOTA_FUNC
    select QCM_URC_FUNC
    select QCM_UTILS_UTILS_FUNC
    default n

config QAPP_UNIRTOS_MMS_AT_FUNC
    bool "Enable MMS AT command"
    select QAPP_UNIRTOS_STD_FUNC
    select QCM_MMS_FUNC
    select QCM_FILE_API_FUNC
    select QCM_UTILS_UTILS_FUNC
    select QCM_URC_FUNC
    default n

config QAPP_UNIRTOS_UNIFY_AT_FUNC
    bool "Enable UNIFY AT command"
    select QAPP_UNIRTOS_STD_FUNC
    select QCM_MQTT_FUNC
    select QCM_URC_FUNC
    default n

config QAPP_UNIRTOS_MQTT_AT_FUNC
    bool "Enable MQTT AT command"
    select QAPP_UNIRTOS_STD_FUNC
    select QCM_MQTT_FUNC
    select QCM_URC_FUNC
    select QCM_UTILS_UTILS_FUNC
    default n

config QAPP_UNIRTOS_PING_AT_FUNC
    bool "Enable PING AT command"
    select QAPP_UNIRTOS_STD_FUNC
    select QCM_PING_FUNC
    select QCM_URC_FUNC
    default n

config QAPP_UNIRTOS_NTP_AT_FUNC
    bool "Enable NTP AT command"
    select QAPP_UNIRTOS_STD_FUNC
    select QCM_NTP_FUNC
    select QCM_URC_FUNC
    default n

config QAPP_UNIRTOS_WEBSOCKET_AT_FUNC
    bool "Enable websocket AT command"
    select QAPP_UNIRTOS_STD_FUNC
    select QCM_WEBSOCKET_FUNC
    select QCM_URC_FUNC
    select QCM_FILE_API_FUNC
    default n

config QAPP_UNIRTOS_DMHTTP_AT_FUNC
    bool "Enable CMCC device management AT command"
    select QAPP_UNIRTOS_STD_FUNC
    select QCM_URC_FUNC
    select QCM_DMHTTP_FUNC
    default n

config QAPP_UNIRTOS_UNIFY_IDENTITY_FUNC
    bool "Enable UNIFY IDENTITY function"
    select QAPP_UNIRTOS_STD_FUNC
    select QAPP_UNIRTOS_UNIFY_AT_FUNC
    select QCM_MQTT_FUNC
    select QCM_UTILS_UTILS_FUNC
    default n

config QAPP_UNIRTOS_SIM_AT_FUNC
    bool "Enable SIM AT command"
    select QAPP_UNIRTOS_STD_FUNC
    select QOSA_SIM_FUNC
    select QCM_URC_FUNC
    select QCM_UTILS_UTILS_FUNC
    default n

config QAPP_UNIRTOS_SMS_AT_FUNC
    bool "Enable SMS AT command"
    select QAPP_UNIRTOS_STD_FUNC
    select QOSA_SMS_FUNC
    select QCM_URC_FUNC
    select QCM_UTILS_UTILS_FUNC
    default n

config QAPP_UNIRTOS_LED_AT_FUNC
    bool "Enable LED AT command"
    select QAPP_UNIRTOS_STD_FUNC
    select QOSA_LED_FUNC
    select QOSA_NW_FUNC
    default n

config QAPP_UNIRTOS_LICENSE_AT_FUNC
    bool "Enable license management AT command"
    select QAPP_UNIRTOS_STD_FUNC
    select QOSA_LICENSE_FUNC
    default n

config QAPP_UNIRTOS_NW_AT_FUNC
    bool "Enable NW AT command"
    select QAPP_UNIRTOS_STD_FUNC
    select QOSA_NW_FUNC
    select QCM_URC_FUNC
    select QCM_UTILS_UTILS_FUNC
    select QAPP_UNIRTOS_MODEM_AT_BYPASS_FUNC
    default n

config QAPP_UNIRTOS_USBNET_AT_FUNC
    bool "Enable USBNET AT command"
    select QAPP_UNIRTOS_STD_FUNC
    select QCM_URC_FUNC
    default n

config QAPP_UNIRTOS_QNWPREFCFG_AT_FUNC
    bool "Enable +QNWPREFCFG AT command"
    select QAPP_UNIRTOS_STD_FUNC
    select QOSA_NW_FUNC
    default n

config QAPP_UNIRTOS_DATACALL_AT_FUNC
    bool "Enable DATACALL AT command"
    select QAPP_UNIRTOS_STD_FUNC
    select QOSA_DATACALL_FUNC
    select QCM_UTILS_UTILS_FUNC
    select QOSA_NW_FUNC
    default n

config QAPP_UNIRTOS_DEV_AT_FUNC
    bool "Enable device AT command"
    select QAPP_UNIRTOS_STD_FUNC
    select QOSA_MODEM_DEV_FUNC
    default n

config QAPP_UNIRTOS_PDP_AT_FUNC
    bool "Enable PDP AT command"
    select QAPP_UNIRTOS_STD_FUNC
    select QCM_URC_FUNC
    default n

config QAPP_UNIRTOS_QINDCFG_AT_FUNC
    bool "Enable +QINDCFG AT command"
    select QAPP_UNIRTOS_STD_FUNC
    select QCM_URC_FUNC
    default n

choice QAPP_FOTA_HTTP_BACKEND
    prompt "Select HTTP backend for FOTA"

config QAPP_FOTA_USE_QURL_HTTP_FUNC
    bool "Enable FOTA AT command with QURL HTTP"
    select QCM_QURL_HTTP_FUNC

config QAPP_FOTA_USE_MINI_HTTP_FUNC
    bool "Enable FOTA AT command with MINI HTTP"
    select QCM_MINI_HTTP_FUNC
endchoice

config QAPP_UNIRTOS_FOTA_AT_FUNC
    bool "Enable FOTA AT command"
    select QAPP_UNIRTOS_STD_FUNC
    select QCM_FILE_API_FUNC
    select QCM_URC_FUNC
    depends on (QAPP_FOTA_USE_QURL_HTTP_FUNC || QAPP_FOTA_USE_MINI_HTTP_FUNC)
    default n

config QAPP_UNIRTOS_PPP_AT_FUNC
    bool "Enable PPP AT command"
    select QAPP_UNIRTOS_STD_FUNC
    select QOSA_PPP_FUNC

config QAPP_UNIRTOS_PDP_KALIVE_FUNC
    bool "Enable PDP keepalive AT command"
    select QAPP_UNIRTOS_STD_FUNC
    default n

config QAPP_UNIRTOS_LBS_AT_FUNC
    bool "Enable LBS AT command"
    select QAPP_UNIRTOS_STD_FUNC
    select QCM_LBS_FUNC
    select QCM_URC_FUNC
    default n

config QAPP_UNIRTOS_UART_AT_FUNC
    bool "Enable UART AT command"
    select QAPP_UNIRTOS_STD_FUNC
    default n

config QAPP_UNIRTOS_AT_CSUB_CMD
    bool "Enable +CSUB AT command"
    select QAPP_UNIRTOS_STD_FUNC
    default n

config QAPP_UNIRTOS_AT_QINF_CMD
    bool "Enable +QINF AT command"
    select QAPP_UNIRTOS_STD_FUNC
    default n

config QAPP_UNIRTOS_AT_QGMR_CMD
    bool "Enable +QGMR AT command"
    select QAPP_UNIRTOS_STD_FUNC
    default n

config QAPP_UNIRTOS_FACTORY_AT_FUNC
    bool "Enable FACTORY AT command"
    select QAPP_UNIRTOS_STD_FUNC
    default n

config QAPP_UNIRTOS_AT_QPROD_CMD
    bool "Enable +QPROD AT command"
    select QAPP_UNIRTOS_STD_FUNC
    select QAPP_UNIRTOS_FACTORY_AT_FUNC
    default n

config QAPP_UNIRTOS_AT_PROD_CMD
    bool "Enable +PROD AT command"
    select QAPP_UNIRTOS_STD_FUNC
    select QAPP_UNIRTOS_FACTORY_AT_FUNC
    default n

config QAPP_UNIRTOS_AT_EGMR_CMD
    bool "Enable +EGMR AT command"
    select QAPP_UNIRTOS_STD_FUNC
    select QAPP_UNIRTOS_FACTORY_AT_FUNC
    default n

config QAPP_UNIRTOS_AT_QSVN_CMD
    bool "Enable +QSVN AT command"
    select QAPP_UNIRTOS_STD_FUNC
    select QAPP_UNIRTOS_FACTORY_AT_FUNC
    default n

config QAPP_UNIRTOS_AT_HVERSION_CMD
    bool "Enable +HVERSION AT command"
    select QAPP_UNIRTOS_STD_FUNC
    default n

config QAPP_UNIRTOS_AT_MODULE_CMD
    bool "Enable +MODULE AT command"
    select QAPP_UNIRTOS_STD_FUNC
    default n

config QAPP_UNIRTOS_AT_QPOWD_CMD
    bool "Enable +QPOWD AT command"
    select QAPP_UNIRTOS_STD_FUNC
    default n

config QAPP_UNIRTOS_AT_CBC_CMD
    bool "Enable +CBC AT command"
    select QAPP_UNIRTOS_STD_FUNC
    default n

config QAPP_UNIRTOS_AT_QTEMP_CMD
    bool "Enable +QTEMP AT command"
    select QAPP_UNIRTOS_STD_FUNC
    default n

config QAPP_UNIRTOS_AT_QADC_CMD
    bool "Enable +QADC AT command"
    select QAPP_UNIRTOS_STD_FUNC
    default n

config QAPP_UNIRTOS_AT_QRESET_CMD
    bool "Enable +QRESET AT command"
    select QAPP_UNIRTOS_STD_FUNC
    default n

config QAPP_UNIRTOS_AT_QDOWNLOAD_CMD
    bool "Enable +QDOWNLOAD AT command"
    select QAPP_UNIRTOS_STD_FUNC
    default n

config QAPP_UNIRTOS_AT_ATO_CMD
    bool "Enable ATO AT command"
    select QAPP_UNIRTOS_STD_FUNC
    default n

config QAPP_UNIRTOS_AT_CFUN_CMD
    bool "Enable +CFUN AT command"
    select QAPP_UNIRTOS_STD_FUNC
    select QAPP_UNIRTOS_DEV_AT_FUNC
    default n

config QAPP_UNIRTOS_AT_CCLK_CMD
    bool "Enable +CCLK AT command"
    select QAPP_UNIRTOS_STD_FUNC
    select QAPP_UNIRTOS_DEV_AT_FUNC
    default n

config QAPP_UNIRTOS_AT_RETSET_CMD
    bool "Enable +RETSET AT command"
    select QAPP_UNIRTOS_STD_FUNC
    default n

config QHTTPCFG_CUSTOM_HEADER_EMPTY_SHOW
    bool "Enable display of qhttpcfg custom header when the value is empty （fixme）"
    select QAPP_UNIRTOS_STD_FUNC
    select QAPP_UNIRTOS_HTTP_AT_FUNC
    select QCM_QURL_FUNC
    default n

config QAPP_UNIRTOS_AT_STYLE_REG_FUNC
    bool "Enable registration using the UniRTOS AT parser style command （fixme）"
    select QAPP_UNIRTOS_STD_FUNC
    default n

config QAPP_UNIRTOS_HTTP_FOTA_AT_FUNC
    bool "Enable qfotadl AT command based on HTTP protocol"
    select QAPP_UNIRTOS_STD_FUNC
    select QAPP_UNIRTOS_HTTP_AT_FUNC
    select QAPP_UNIRTOS_FOTA_AT_FUNC
    default n

config QAPP_UNIRTOS_FTP_FOTA_AT_FUNC
    bool "Enable qfotadl AT command based on FTP protocol"
    select QAPP_UNIRTOS_STD_FUNC
    select QAPP_UNIRTOS_FTP_AT_FUNC
    select QAPP_UNIRTOS_FOTA_AT_FUNC
    select QAPP_UNIRTOS_SSL_AT_FUNC
    default n

config QAPP_UNIRTOS_SBFOTA_AT_FUNC
    bool "Enable SBFOTA AT command"
    select QAPP_UNIRTOS_STD_FUNC
    select QCM_SBFOTA_FUNC
    select QCM_FILE_API_FUNC
    select QCM_UTILS_BASE64_FUNC
    select QCM_URC_FUNC
    select QAPP_UNIRTOS_FOTA_AT_FUNC
    default n

config QAPP_UNIRTOS_AT_GPIO_CMD
    bool "Enable +QGPIOCFG AT command"
    select QAPP_UNIRTOS_STD_FUNC
    default n

config QAPP_UNIRTOS_WIFISCAN_AT_FUNC
    bool "Enable +QWIFISCAN AT command"
    select QOSA_WIFISCAN_FUNC
    select QCM_URC_FUNC
    default n

config QAPP_UNIRTOS_QDMZ_AT_FUNC
    bool "Enable +QDMZ AT command"
    select QAPP_UNIRTOS_STD_FUNC
    default n

config QAPP_UNIRTOS_AT_LPM_FUNC
    bool "Enable LPM AT command"
    select QAPP_UNIRTOS_STD_FUNC
    select QOSA_LPM_FUNC
    select QCM_URC_FUNC
    select QOSA_NW_FUNC
    default n

config QAPP_UNIRTOS_AT_URC_FUNC
    bool "Enable URC AT command"
    select QAPP_UNIRTOS_STD_FUNC
    select QCM_URC_FUNC
    default n

config QAPP_UNIRTOS_AT_QVSIM_FUNC
    bool "Enable +QVSIM AT command"
    select QAPP_UNIRTOS_STD_FUNC
    select QCM_QVSIM_FUNC
    select QCM_URC_FUNC
    default n

config QAPP_UNIRTOS_FTM_AT_FUNC
    bool "Enable RFTEST AT command"
    select QAPP_UNIRTOS_STD_FUNC
    select QOSA_FTM_FUNC
    default n

config QAPP_UNIRTOS_AT_IPR_CMD
    bool "Enable +IPR AT command"
    select QAPP_UNIRTOS_STD_FUNC
    select QAPP_UNIRTOS_UART_AT_FUNC
    default n

config QAPP_UNIRTOS_AT_ICF_CMD
    bool "Enable +ICF AT command"
    select QAPP_UNIRTOS_STD_FUNC
    select QAPP_UNIRTOS_UART_AT_FUNC
    default n

config QAPP_UNIRTOS_AT_IFC_CMD
    bool "Enable +IFC AT command"
    select QAPP_UNIRTOS_STD_FUNC
    select QAPP_UNIRTOS_UART_AT_FUNC
    default n

config QAPP_UNIRTOS_AT_CBAUD_CMD
    bool "Enable +CBAUD AT command"
    select QAPP_UNIRTOS_STD_FUNC
    select QAPP_UNIRTOS_UART_AT_FUNC
    default n

config QAPP_UNIRTOS_AT_CVERSION_CMD
    bool "Enable +CVERSION AT command"
    select QAPP_UNIRTOS_STD_FUNC
    default n

config QAPP_UNIRTOS_AT_QVERINFO_CMD
    bool "Enable *QVERINFO AT command"
    select QAPP_UNIRTOS_STD_FUNC
    default n

config QAPP_UNIRTOS_AT_QAPPVERSION_CMD
    bool "Enable +QAPPVERSION AT command"
    select QAPP_UNIRTOS_STD_FUNC
    default n

config QAPP_UNIRTOS_AT_QWSETMAC_CMD
    bool "Enable +QWSETMAC AT command"
    select QAPP_UNIRTOS_STD_FUNC
    select QAPP_UNIRTOS_FACTORY_AT_FUNC
    default n

config QAPP_UNIRTOS_AT_QCFG_CMD
    bool "Enable +QCFG AT command"
    select QAPP_UNIRTOS_STD_FUNC
    default n

config QAPP_UNIRTOS_AT_QCFG_NWSCANSEQ_CMD
    bool "Enable +QCFG NWSCANSEQ AT command"
    select QAPP_UNIRTOS_STD_FUNC
    select QAPP_UNIRTOS_AT_QCFG_CMD
    select QAPP_UNIRTOS_NW_AT_FUNC
    default n

config QAPP_UNIRTOS_AT_QDBGCFG_CMD
    bool "Enable +QDBGCFG AT command"
    select QAPP_UNIRTOS_STD_FUNC
    default n

config QAPP_UNIRTOS_AT_QDBGCFG_DUMPCFG_CMD
    bool "Enable +QDBGCFG DUMPCFG AT command"
    select QAPP_UNIRTOS_STD_FUNC
    select QAPP_UNIRTOS_AT_QDBGCFG_CMD
    default n

config QAPP_UNIRTOS_AT_QDBGCFG_IPTRACE_CMD
    bool "Enable +QDBGCFG IPTRACE AT command"
    select QAPP_UNIRTOS_STD_FUNC
    select QAPP_UNIRTOS_AT_QDBGCFG_CMD
    default n

config QAPP_UNIRTOS_AT_QDBGCFG_TRACECFG_CMD
    bool "Enable +QDBGCFG TRACECFG AT command"
    select QAPP_UNIRTOS_STD_FUNC
    select QAPP_UNIRTOS_AT_QDBGCFG_CMD
    default n

config QAPP_UNIRTOS_AT_QDBGCFG_SLEEP_DEBUG_CMD
    bool "Enable +QDBGCFG SLEEP/DEBUG AT command"
    select QAPP_UNIRTOS_STD_FUNC
    select QAPP_UNIRTOS_AT_QDBGCFG_CMD
    select QOSA_LPM_SLEEP_LOG_FUNC
    default n

config QAPP_UNIRTOS_NB_AT_FUNC
    bool "Enable NB-IoT AT command"
    select QAPP_UNIRTOS_STD_FUNC
    select QOSA_NW_FUNC
    default n

config QAPP_UNIRTOS_AT_QIND_DATASTATUS_CMD
    bool "Enable +QIND DATASTATUS indication AT command"
    select QAPP_UNIRTOS_STD_FUNC
    select QAPP_UNIRTOS_QINDCFG_AT_FUNC
    default n
    help
      Data service status indication. Disabled by default.
      If enabled, the module will report URC:
        +QIND: "datastatus",<suspended>,<reason>

      <reason> is an integer, with the following values:
        0  SUSPEND_NO_CAUSE
        1  SUSPEND_BY_RAU_ATTACH
        2  SUSPEND_BY_LAU
        3  SUSPEND_BY_TAU
        4  SUSPEND_BY_CS_SERVICE
        5  SUSPEND_BY_DS_OPERATION

config QAPP_UNIRTOS_AT_QIND_MODE_CMD
    bool "Enable ^MODE indication AT command"
    select QAPP_UNIRTOS_STD_FUNC
    select QAPP_UNIRTOS_QINDCFG_AT_FUNC
    select QAPP_UNIRTOS_NW_AT_FUNC
    default n
    help
      Network main mode and sub mode indication. Disabled by default.
      If enabled, the module will report URC:
        ^MODE:<main_mode>,<sub_mode>

      <main_mode> is an integer, with the following values:
        0   SYSINFO_SYSTEMO_MODE_NO_SERVICE
        1   SYSINFO_SYSTEMO_MODE_RESERVED_1
        2   SYSINFO_SYSTEMO_MODE_RESERVED_2
        3   SYSINFO_SYSTEMO_MODE_GSM_GPRS
        5   SYSINFO_SYSTEMO_MODE_WCDMA
        17  SYSINFO_SYSTEMO_MODE_LTE

      <sub_mode> is an integer, with the following values:
        0   SYSINFO_SYSTEMO_SUBMODE_NO_SERVICE
        1   SYSINFO_SYSTEMO_SUBMODE_GSM
        3   SYSINFO_SYSTEMO_SUBMODE_GSM_EGPRS
        5   SYSINFO_SYSTEMO_SUBMODE_UTRAN_HSDPA
        6   SYSINFO_SYSTEMO_SUBMODE_UTRAN_HSUPA
        7   SYSINFO_SYSTEMO_SUBMODE_UTRAN_HSPA
        8   SYSINFO_SYSTEMO_SUBMODE_UTRAN
        17  SYSINFO_SYSTEMO_SUBMODE_EUTRAN

config QAPP_UNIRTOS_AT_QWRITESIM_CMD
    bool "Enable +QWRITESIM AT command"
    select QAPP_UNIRTOS_STD_FUNC
    select QAPP_UNIRTOS_SIM_AT_FUNC
    default n

config QAPP_UNIRTOS_AT_QAUDIO_CMD
    bool "Enable AUDIO AT command"
    select QAPP_UNIRTOS_STD_FUNC
    select QCM_AUDIO_STREAM_FUNC
    select QCM_URC_FUNC
    select QCM_FILE_API_FUNC
    default n


config QAPP_UNIRTOS_AT_FLASH_TEST_CMD
    bool "Enable +QFTEST AT command"
    select QAPP_UNIRTOS_STD_FUNC
    select QOSA_FLASH_TEST_FUNC
    select QCM_FILE_API_FUNC
    select QCM_URC_FUNC
    default n

config QAPP_UNIRTOS_AT_QESIM_CMD
    bool "Enable +QESIM AT command"
    select QAPP_UNIRTOS_STD_FUNC
    select QCM_ESIM_FUNC
    default n

config QAPP_UNIRTOS_QBAND_AT_FUNC
    bool "Enable +QBAND AT command"
    select QAPP_UNIRTOS_STD_FUNC
    select QAPP_UNIRTOS_NW_AT_FUNC
    default n

config QAPP_UNIRTOS_CEER_AT_FUNC
    bool "Enable +CEER AT command"
    select QAPP_UNIRTOS_STD_FUNC
    select QAPP_UNIRTOS_NW_AT_FUNC
    default n

config QAPP_UNIRTOS_QCEER_AT_FUNC
    bool "Enable +QCEER AT command"
    select QAPP_UNIRTOS_STD_FUNC
    select QAPP_UNIRTOS_NW_AT_FUNC
    default n

config QAPP_UNIRTOS_JD_AT_FUNC
    bool "Enable jam detect AT command"
    select QAPP_UNIRTOS_STD_FUNC
    select QCM_URC_FUNC
    default n

config QAPP_UNIRTOS_GNSS_AT_FUNC
    bool "Enable GNSS AT command"
    select QAPP_UNIRTOS_STD_FUNC
    select QCM_GNSS_FUNC
    default n

config QAPP_UNIRTOS_AT_CIND_CMD
    bool "Enable +CIND AT command"
    select QAPP_UNIRTOS_STD_FUNC
    select QCM_URC_FUNC
    select QOSA_NW_FUNC
    default n

config QAPP_UNIRTOS_CGEREP_AT_FUNC
    bool "Enable +CGEREP AT command"
    select QAPP_UNIRTOS_STD_FUNC
    select QAPP_UNIRTOS_NW_AT_FUNC
    default n

config QAPP_UNIRTOS_CEMODE_AT_FUNC
    bool "Enable +CEMODE AT command"
    select QAPP_UNIRTOS_STD_FUNC
    select QAPP_UNIRTOS_NW_AT_FUNC
    default n

config QAPP_UNIRTOS_TLS1_3
    bool "Enable Quectel TLS 1.3 AT command"
    select QAPP_UNIRTOS_SSL_AT_FUNC
    default n

config QAPP_UNIRTOS_AT_QCFG_DHCP_CFG_CMD
    bool "Enable +QCFG DHCP CFG AT command"
    select QAPP_UNIRTOS_STD_FUNC
    default n

config QAPP_UNIRTOS_AT_QREDDAAVN_CMD
    bool "Enable +QREDDAAVN AT command"
    select QAPP_UNIRTOS_STD_FUNC
    default n

config QAPP_UNIRTOS_SECBOOT_AT_FUNC
    bool "Enable SecBoot AT command"
    select QAPP_UNIRTOS_STD_FUNC
    select QOSA_SECBOOT_FUNC
    default n

config QAPP_OEM_LT_AT_FUNC
    bool "Enable OEM LT AT command"
    select QAPP_UNIRTOS_STD_FUNC
    select QOSA_OEM_LT_FUNC
    select QOSA_NW_FUNC
    default n

config QAPP_UNIRTOS_AT_QCFG_PDPREACT_CMD
    bool "Enable +QCFG PDPREACT AT command"
    select QAPP_UNIRTOS_STD_FUNC
    select QAPP_UNIRTOS_DATACALL_AT_FUNC
    default n

config QAPP_UNIRTOS_AT_QCFG_SIMWPROTECT_CMD
    bool "Enable +QCFG simwpprotect AT command"
    select QAPP_UNIRTOS_STD_FUNC
    select QAPP_UNIRTOS_SIM_AT_FUNC
    default n

config QAPP_UNIRTOS_AT_QCFG_SERVICE_DOMAIN_CMD
    bool "Enable +QCFG service domain AT command"
    select QAPP_UNIRTOS_STD_FUNC
    select QOSA_NW_FUNC
    default n

config QAPP_UNIRTOS_AT_CALL_CONTROL_CMD
    bool "Enable VOICE CALL AT command"
    select QAPP_UNIRTOS_STD_FUNC
    select QOSA_CALL_CONTROL_FUNC
    default n

config QAPP_UNIRTOS_IMS_AT_FUNC
    bool "Enable +QCFG IMS AT command"
    select QAPP_UNIRTOS_STD_FUNC
    default n

config QAPP_UNIRTOS_CLAT_AT_FUNC
    bool "Enable +QCFG CLAT AT command"
    depends on QAPP_UNIRTOS_STD_FUNC
    depends on QOSA_CLAT_FUNC
    default n

config QAPP_UNIRTOS_SENDHEX
    bool "Enable Configure the result for AT0 sending ok and sending fail not to be converted to numbers （fixme）"
    select QAPP_UNIRTOS_STD_FUNC
    select QAPP_UNIRTOS_TCPIP_AT_FUNC
    default n

config QAPP_UNIRTOS_AT_QFMD5_CMD
    bool "Enable +QFMD5 AT command"
    select QAPP_UNIRTOS_STD_FUNC
    select QAPP_UNIRTOS_FILE_AT_FUNC
    default n

config UNIRTOS_FLASH_REPAIR_ERASE_TEST_AT_FUNC
    bool "Enable +QFTEST AT command"
    depends on QAPP_UNIRTOS_STD_FUNC
    depends on QOSA_FLASH_TEST_FUNC
    default n

config QAPP_AUTOAPN_AT_FUNC
    bool "Enable AUTOAPN AT command"
    depends on QAPP_UNIRTOS_STD_FUNC
    depends on QOSA_AUTOAPN_FUNC
    default n

config QAPP_UNIRTOS_ABNORMAL_BASESTATION_AT_FUNC
    bool "Enable abnormal basestation AT command"
    depends on QAPP_UNIRTOS_STD_FUNC
    depends on QOSA_ABNORMAL_BASESTATION_FUNC
    default n

# if QOSA_FEATURE_ALLOW_CHANGE
# orsource "unirtos_std_config.Kconfig"
# endif

endmenu
```
